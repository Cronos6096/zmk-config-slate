## boards/shields/slate/Kconfig.shield
```kconfig
config SHIELD_SLATE_SINISTRA
    def_bool $(shields_list_contains,slate_sinistra)

config SHIELD_SLATE_DESTRA
    def_bool $(shields_list_contains,slate_destra)

config SHIELD_SLATE_DONGLE
    def_bool $(shields_list_contains,slate_dongle)
```
