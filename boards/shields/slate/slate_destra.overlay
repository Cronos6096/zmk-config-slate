#include "slate.dtsi"

&default_transform {
    col-offset = <9>;
};

&kscan0 {
    col-gpios
        = <&pro_micro 14 GPIO_ACTIVE_HIGH> // 111
        , <&pro_micro 15 GPIO_ACTIVE_HIGH> // 113
        , <&pro_micro 8 GPIO_ACTIVE_HIGH>  // 104
        , <&pro_micro 9 GPIO_ACTIVE_HIGH>  // 106
        , <&pro_micro 7 GPIO_ACTIVE_HIGH>  // 011
        , <&pro_micro 5 GPIO_ACTIVE_HIGH>  // 024
        , <&pro_micro 4 GPIO_ACTIVE_HIGH>  // 022
        , <&pro_micro 3 GPIO_ACTIVE_HIGH>  // 020
        , <&pro_micro 2 GPIO_ACTIVE_HIGH>  // 017
        ;
};
